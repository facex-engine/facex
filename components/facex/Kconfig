## components/facex/Kconfig
```kconfig
menu "FaceX"

    choice FACEX_BACKEND
        prompt "Inference backend"
        default FACEX_BACKEND_STUB
        help
            Selects which face-detection / embedding implementation
            facex_esp_detect() dispatches to.

        config FACEX_BACKEND_STUB
            bool "Stub (synthetic faces, ~0 KB)"
            help
                Returns a single synthetic face per frame. Use this to
                wire up the camera + display + UI without committing
                to a real model — useful for board bring-up.

        config FACEX_BACKEND_NATIVE
            bool "Native FaceX engine (EdgeFace-XS, EXPERIMENTAL)"
            help
                Pulls in the full src/edgeface_engine.c. The model
                weights (~7 MB FP32 / ~1.8 MB INT8) require PSRAM and
                will be SLOW on a 360 MHz P4 — multi-second per frame.
                Intended for evaluation, NOT for shipping. The
                production-ready path is FACEX_BACKEND_ESPNN +
                EdgeFace-Nano — see docs/esp32p4.md.

        config FACEX_BACKEND_ESPNN
            bool "ESP-NN backend (EdgeFace-Nano, NOT IMPLEMENTED)"
            depends on 0   # gated until distilled model + esp-nn backend land
            help
                Reserved. Will dispatch convolutions through Espressif's
                esp-nn (PIE-SIMD INT8) library running a distilled
                ~300 K-param EdgeFace-Nano model. Tracks plan sprint C5.
    endchoice

    config FACEX_DETECT_INPUT_W
        int "Detector input width"
        default 96
        range 32 320
        help
            Input image width passed to facex_esp_detect(). Camera
            frames are downscaled to this size before inference.
            Smaller = faster, larger = better recall on small faces.

    config FACEX_DETECT_INPUT_H
        int "Detector input height"
        default 96
        range 32 320

    config FACEX_LOG_PER_FRAME
        bool "Log per-frame detection result"
        default n
        help
            If enabled, every processed frame logs its bbox + score
            via ESP_LOGI. Spammy at 30 FPS — use for bring-up only.

endmenu
```

## examples/esp32p4_camera/main/Kconfig.projbuild
```kconfig
menu "Camera example"

    config CAM_HRES
        int "Sensor horizontal resolution"
        default 800
        help
            Native sensor output width. SC2336 default is 1280x720;
            we use 800x640 to keep DRAM frame budget under 1 MB at
            RGB565. Override for your sensor.

    config CAM_VRES
        int "Sensor vertical resolution"
        default 640

    config CAM_LANE_BIT_RATE_MBPS
        int "MIPI CSI lane bit rate (Mbps)"
        default 200
        range 80 1500
        help
            Per-lane bit rate negotiated with the sensor. Must match
            the sensor's clock-tree configuration. SC2336 800x640 at
            30 fps fits in 200 Mbps × 2 lanes.

    config CAM_DATA_LANES
        int "Number of MIPI CSI data lanes"
        default 2
        range 1 2

    config SCCB_PORT
        int "I2C port for SCCB sensor control"
        default 0

    config SCCB_SCL_GPIO
        int "I2C SCL GPIO"
        default 8

    config SCCB_SDA_GPIO
        int "I2C SDA GPIO"
        default 7

    config SENSOR_RESET_GPIO
        int "Sensor reset GPIO (-1 if unused)"
        default -1

    config SENSOR_PWDN_GPIO
        int "Sensor power-down GPIO (-1 if unused)"
        default -1

    config CAM_FRAME_QUEUE_LEN
        int "CSI frame queue depth"
        default 2
        range 1 8
        help
            Number of frame buffers in flight. 2 is enough for
            single-consumer pipelines (capture → process → free).

endmenu
```

## examples/esp32p4_camera/sdkconfig.defaults
```kconfig
# Defaults for the ESP32-P4 MIPI-CSI + FaceX example.
# Override with `idf.py menuconfig` per board / sensor.

CONFIG_IDF_TARGET="esp32p4"

# CSI PHY needs 2.5 V; the official Function-EV-Board routes the internal
# LDO. The example code calls esp_ldo_acquire_channel() before init.
CONFIG_ESP_LDO_RESERVE_PSRAM=n

# PSRAM (octal, 200 MHz on P4-Function-EV) — frame buffers go here.
CONFIG_SPIRAM=y
CONFIG_SPIRAM_MODE_HEX=y
CONFIG_SPIRAM_TYPE_AUTO=y
CONFIG_SPIRAM_USE_MALLOC=y
CONFIG_SPIRAM_MALLOC_ALWAYSINTERNAL=4096
CONFIG_SPIRAM_TRY_ALLOCATE_WIFI_LWIP=y

# Stack: the camera task does 320x240 BGR888->RGB downscale on a 2 KB stack
# floor, but FaceX dispatch eats more. Bump to 8 KB.
CONFIG_ESP_MAIN_TASK_STACK_SIZE=8192

# CPU at full speed — the MIPI clock budget assumes 360 MHz.
CONFIG_ESP_DEFAULT_CPU_FREQ_MHZ_360=y
CONFIG_ESP_DEFAULT_CPU_FREQ_MHZ=360

# Logs — INFO is enough for normal use; per-frame dumps are noisy.
CONFIG_LOG_DEFAULT_LEVEL_INFO=y
```
